/* Copyright (c) 2013, The Linux Foundation. All rights reserved.
 *
 * This program is free software; you can redistribute it and/or modify
 * it under the terms of the GNU General Public License version 2 and
 * only version 2 as published by the Free Software Foundation.
 *
 * This program is distributed in the hope that it will be useful,
 * but WITHOUT ANY WARRANTY; without even the implied warranty of
 * MERCHANTABILITY or FITNESS FOR A PARTICULAR PURPOSE.  See the
 * GNU General Public License for more details.
 */

/*---------------------------------------------------------------------------
 * This file is autogenerated file using gcdb parser. Please do not edit it.
 * Update input XML file to add a new entry or update variable in this file
 * VERSION = "1.0"
 *---------------------------------------------------------------------------*/
&mdss_mdp {
	dsi_oppo14043byd_fwvga_video: qcom,mdss_dsi_oppo14043byd_fwvga_video {
		qcom,mdss-dsi-panel-name = "oppo14043byd fwvga video mode dsi panel";
		qcom,mdss-dsi-panel-manufacture = "BYD";
		qcom,mdss-dsi-panel-version = "HX8379";
		qcom,mdss-dsi-panel-controller = <&mdss_dsi0>;
		qcom,mdss-dsi-panel-type = "dsi_video_mode";
		qcom,mdss-dsi-panel-destination = "display_1";
		qcom,mdss-dsi-panel-framerate = <60>;
		qcom,mdss-dsi-virtual-channel-id = <0>;
		qcom,mdss-dsi-stream = <0>;
		qcom,mdss-dsi-panel-width = <480>;
		qcom,mdss-dsi-panel-height = <854>;
		qcom,mdss-dsi-h-front-porch = <58>;
		qcom,mdss-dsi-h-back-porch = <59>;
		qcom,mdss-dsi-h-pulse-width = <10>;
		qcom,mdss-dsi-h-sync-skew = <0>;
		qcom,mdss-dsi-v-back-porch = <3>;
		qcom,mdss-dsi-v-front-porch = <17>;
		qcom,mdss-dsi-v-pulse-width = <8>;
		qcom,mdss-dsi-h-left-border = <0>;
		qcom,mdss-dsi-h-right-border = <0>;
		qcom,mdss-dsi-v-top-border = <0>;
		qcom,mdss-dsi-v-bottom-border = <0>;
		qcom,mdss-dsi-bpp = <24>;
		qcom,mdss-dsi-color-order = "rgb_swap_rgb";
		qcom,mdss-dsi-underflow-color = <0xff>;
		qcom,mdss-dsi-border-color = <0>;
		qcom,mdss-dsi-on-command = [39 01 00 00 00 00 04 B9 FF 83 79
				39 01 00 00 00 00 15 B1 64 19 19 31 31 50 D0 EC 54 80 38 38 F8 22 22 22 00 80 30 00
				39 01 00 00 00 00 0A B2 80 FE 0B 04 00 50 11 42 1D
				39 01 00 00 00 00 0B B4 6E 6E 6E 6E 6E 6E 22 86 23 86
				39 01 00 00 00 00 02 CC 02
				39 01 00 00 00 00 02 D2 44
				39 01 00 00 00 00 1E D3 00 07 00 00 00 06 06 32 10 04 00 04 03 6E 03 6E 00 06 00 06 21 22 05 05 23 05 05 23 09
				39 01 00 00 00 00 21 D5 18 18 19 19 01 00 03 02 21 20 18 18 18 18 18 18 18 18 18 18 18 18 18 18 18 18 18 18 18 18 18 18 
				39 01 00 00 00 00 21 D6 18 18 18 18 00 01 02 03 20 21 19 19 18 18 18 18 18 18 18 18 18 18 18 18 18 18 18 18 18 18 18 18 
				39 01 00 00 00 00 2B E0 00 20 24 32 39 3F 2C 42 07 0B 0D 17 0E 12 15 14 14 06 11 12 17 00 1F 25 32 39 3F 2D 42 06 09 0B 17 0E 11 14 12 13 06 10 12 18
				39 01 00 00 00 00 02 BD 00
				39 01 00 00 00 00 2C C1 01 00 02 07 13 1C 26 2E 35 40 48 50 58 5F 66 6E 76 7E 85 8D 94 9C A4 AD B5 BC C4 CC D3 DB E3 E9 F1 F8 3A C2 04 B9 01 51 45 2F C0
				39 01 00 00 00 00 02 BD 01
				39 01 00 00 00 00 2B C1 00 02 07 13 1C 26 2E 35 40 48 50 58 5F 66 6E 76 7E 85 8D 94 9C A4 AD B5 BC C4 CC D3 DB E3 E9 F1 F8 3A C2 04 B9 01 51 45 2F C0
				39 01 00 00 00 00 02 BD 02
				39 01 00 00 00 00 2B C1 00 02 07 13 1C 26 2E 35 40 48 50 58 5F 66 6E 76 7E 85 8D 94 9C A4 AD B5 BC C4 CC D3 DB E3 E9 F1 F8 3A C2 04 B9 01 51 45 2F C0
				39 01 00 00 00 00 03 B6 4F 4F
				39 01 00 00 00 00 02 35 00
				05 01 00 00 78 00 02 11 00
				05 01 00 00 32 00 02 29 00];
		qcom,mdss-dsi-off-command = [05 01 00 00 32 00 02 28 00
					05 01 00 00 78 00 02 10 00];
		qcom,mdss-dsi-on-command-state = "dsi_lp_mode";
		qcom,mdss-dsi-off-command-state = "dsi_hs_mode";
		qcom,mdss-dsi-panel-status-command = [06 01 00 01 05 00 02 0A 08];
		qcom,mdss-dsi-panel-status-command-state = "dsi_lp_mode";
		qcom,mdss-dsi-panel-status-check-mode = "reg_read";
		qcom,mdss-dsi-panel-status-value = <0x1C>;
		qcom,mdss-dsi-tx-eot-append;
		qcom,mdss-dsi-h-sync-pulse = <1>;
		qcom,mdss-dsi-traffic-mode = "burst_mode";
		qcom,mdss-dsi-lane-map = "lane_map_3012";
		qcom,mdss-dsi-bllp-eof-power-mode;
		qcom,mdss-dsi-bllp-power-mode;
		qcom,mdss-dsi-lane-0-state;
		qcom,mdss-dsi-lane-1-state;
		qcom,mdss-dsi-panel-timings = [76 18 10 00 3a 3e 14 1c 12 03 04 00];
		qcom,mdss-dsi-t-clk-post = <0x04>;
		qcom,mdss-dsi-t-clk-pre = <0x19>;
		qcom,mdss-dsi-bl-min-level = <1>;
		qcom,mdss-dsi-bl-max-level = <255>;
		qcom,mdss-dsi-dma-trigger = "trigger_sw";
		qcom,mdss-dsi-mdp-trigger = "none";
		qcom,mdss-dsi-bl-pmic-control-type = "bl_ctrl_wled";
		qcom,mdss-dsi-reset-sequence = <1 20>, <0 20>, <1 20>;
		qcom,mdss-pan-physical-width-dimension = <59>;
		qcom,mdss-pan-physical-height-dimension = <104>;
	};
};
